## config/west.yml
```yaml
manifest:
  remotes:
    - name: zmkfirmware
      url-base: https://github.com/zmkfirmware
    # See https://docs.zephyrproject.org/3.2.0/develop/west/manifest.html#projects
  projects:
    - name: zmk
      remote: zmkfirmware
      revision: v0.3.0
      import: app/west.yml
  self:
    path: config
```

## zephyr/boards/arm/waveshare_rp2040_plus/Kconfig.board
```kconfig
config BOARD_WAVESHARE_RP2040_PLUS
    bool "Waveshare RP2040-Plus"
    depends on SOC_RP2040
```

## zephyr/boards/arm/waveshare_rp2040_plus/Kconfig.defconfig
```kconfig
if BOARD_WAVESHARE_RP2040_PLUS

config ZMK_KEYBOARD_NAME
    default "Waveshare RP2040-Plus"

config USB
    default y

config USB_DEVICE_STACK
    default y

endif
```

## zephyr/boards/arm/waveshare_rp2040_plus/waveshare_rp2040_plus_defconfig
```kconfig
CONFIG_SOC_RP2040=y
CONFIG_BOARD_WAVESHARE_RP2040_PLUS=y

CONFIG_GPIO=y
CONFIG_SPI=y
CONFIG_I2C=y
CONFIG_PWM=y

CONFIG_USB_DEVICE_STACK=y
CONFIG_USB_CDC_ACM=y

CONFIG_FLASH=y
CONFIG_FLASH_MAP=y
CONFIG_BOOTLOADER_MCUBOOT=n
```
